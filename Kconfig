## drivers/gpio/Kconfig
```kconfig
config GPIO_TXE81XX
	bool "TXE81xx SPI GPIO expander driver"
	default y
	depends on DT_HAS_XYLON_LABS_TXE8116_ENABLED || DT_HAS_XYLON_LABS_TXE8124_ENABLED
	depends on SPI
	select GPIO
	help
	  Enable support for the Texas Instruments TXE81xx series
	  SPI GPIO expander (TXE8116 and TXE8124).

	  The TXE8116 provides 16 I/O pins (2 ports) and the TXE8124
	  provides 24 I/O pins (3 ports), each configured via an SPI
	  register interface.

if GPIO_TXE81XX

config GPIO_TXE81XX_INIT_PRIORITY
	int "Init priority"
	default 80
	help
	  Device driver initialization priority. Must be higher than
	  the SPI bus driver priority.

endif # GPIO_TXE81XX
```

## dts/bindings/xylon-labs,txe8116.yaml
```yaml
description: |
  Texas Instruments TXE8116 SPI GPIO expander.

  16 I/O pins arranged as 2 ports of 8 bits each.
  Pin numbering: pins 0-7 map to port 0, pins 8-15 map to port 1.

  Example:
    &spi1 {
      txe8116: txe8116@0 {
        compatible = "xylon,txe8116";
        reg = <0>;
        spi-max-frequency = <312500>;
        reset-gpios = <&gpioc 6 GPIO_ACTIVE_LOW>;
        irq-gpios   = <&gpioc 7 GPIO_ACTIVE_LOW>;
        gpio-controller;
        #gpio-cells = <2>;
        ngpios = <16>;
      };
    };

compatible: "xylon-labs,txe8116"

include: xylon-labs,txe81xx-base.yaml

properties:
  ngpios:
    type: int
    const: 16
    description: Number of GPIO pins. Fixed at 16 for TXE8116.
```

## dts/bindings/xylon-labs,txe8124.yaml
```yaml
description: |
  Texas Instruments TXE8124 SPI GPIO expander.

  24 I/O pins arranged as 3 ports of 8 bits each.
  Pin numbering: pins 0-7 map to port 0, pins 8-15 map to port 1,
  pins 16-23 map to port 2.

  Example:
    &spi1 {
      txe8124: txe8124@0 {
        compatible = "xylon,txe8124";
        reg = <0>;
        spi-max-frequency = <312500>;
        reset-gpios = <&gpioc 6 GPIO_ACTIVE_LOW>;
        irq-gpios   = <&gpioc 7 GPIO_ACTIVE_LOW>;
        gpio-controller;
        #gpio-cells = <2>;
        ngpios = <24>;
      };
    };

compatible: "xylon-labs,txe8124"

include: xylon-labs,txe81xx-base.yaml

properties:
  ngpios:
    type: int
    const: 24
    description: Number of GPIO pins. Fixed at 24 for TXE8124.
    description: Number of GPIO pins. Fixed at 24 for TXE8124.
```

## dts/bindings/xylon-labs,txe81xx-base.yaml
```yaml
# Common properties shared by all TXE81xx variants.
# Not a standalone binding - included by xylon,txe8116.yaml and xylon,txe8124.yaml.

include:
  - name: spi-device.yaml
  - name: gpio-controller.yaml

on-bus: spi

properties:
  reset-gpios:
    type: phandle-array
    description: |
      Active-low reset signal. When asserted (driven low), the device
      is held in reset. Must be released before SPI communication.

  irq-gpios:
    type: phandle-array
    description: |
      Active-low interrupt output from the device. Asserted when an
      input pin changes state (if interrupt mode is enabled).

  glitch-filter-pins:
    type: int
    default: 0
    description: |
      Bitmask of pins for which the glitch filter is enabled at boot.
      Bit N corresponds to absolute pin N (pin 0-7 = port 0, pin 8-15 = port 1, etc.).
      Example: 0x00000101 enables the filter on pin 0 and pin 8.

  led-gpios:
    type: phandle-array
    description: Optional LED GPIO specifier referencing a pin on this device.

  sw-gpios:
    type: phandle-array
    description: Optional switch GPIO specifier referencing a pin on this device.

gpio-cells:
  - pin
  - flags
```

## west.yml
```yaml
manifest:
  self:
    path: zephyr-txe81xx

  projects:
    - name: zephyr
      url: https://github.com/zephyrproject-rtos/zephyr
      revision: v4.3.0
      import: true
```
